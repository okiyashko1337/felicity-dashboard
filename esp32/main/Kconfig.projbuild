## esp32/main/Kconfig.projbuild
```kconfig
menu "Felicity dashboard client"

config FELICITY_EMULATOR
    bool "Run without Wi-Fi and print Nextion commands"
    default n
    help
        Uses deterministic sample values and logs Nextion commands. Intended
        for ESP32-C3 QEMU before the real board and display arrive.

config FELICITY_API_BASE_URL
    string "Raspberry dashboard API base URL"
    default "http://192.168.1.10:8000"

config FELICITY_WIFI_SSID
    string "Fallback Wi-Fi SSID"
    default ""

config FELICITY_WIFI_PASSWORD
    string "Fallback Wi-Fi password"
    default ""

config FELICITY_NEXTION_TX_GPIO
    int "ESP32 TX GPIO connected to Nextion RX"
    range 0 21
    default 4

config FELICITY_NEXTION_RX_GPIO
    int "ESP32 RX GPIO connected to Nextion TX"
    range 0 21
    default 5

config FELICITY_NEXTION_BAUD
    int "Nextion UART baud rate"
    default 115200

config FELICITY_NEXTION_MODEL
    string "Expected Nextion model identifier"
    default "NX4827P043_011C-Y"
    help
        The controller refuses a wireless TFT update unless the model in the
        Nextion connect response matches exactly. This prevents an image for a
        different display from being installed accidentally.

endmenu
```

## esp32/sdkconfig.defaults
```kconfig
CONFIG_IDF_TARGET="esp32c3"
CONFIG_ESPTOOLPY_FLASHSIZE_4MB=y
CONFIG_PARTITION_TABLE_SINGLE_APP_LARGE=y
CONFIG_ESP_MAIN_TASK_STACK_SIZE=8192
CONFIG_FELICITY_API_BASE_URL="http://192.168.1.10:8000"
CONFIG_FELICITY_WIFI_SSID=""
CONFIG_FELICITY_WIFI_PASSWORD=""
CONFIG_FELICITY_NEXTION_TX_GPIO=4
CONFIG_FELICITY_NEXTION_RX_GPIO=5
CONFIG_FELICITY_NEXTION_BAUD=115200
```
